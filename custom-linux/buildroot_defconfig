## custom-linux/buildroot_defconfig
```kconfig
BR2_arm=y
BR2_cortex_a9=y
BR2_KERNEL_HEADERS_3_14=y
BR2_TARGET_GENERIC_HOSTNAME="oli-udoo"
BR2_TARGET_GENERIC_ISSUE="Welcome to oli-udoo"
BR2_PACKAGE_GIT=y
BR2_PACKAGE_SQLITE=y
BR2_PACKAGE_DROPBEAR=y
BR2_PACKAGE_SUDO=y
BR2_TARGET_ROOTFS_TAR_GZIP=y
```
